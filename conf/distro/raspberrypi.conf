## conf/distro/raspberrypi.conf
```bitbake
#@TYPE: Distribution
#@NAME: raspberrypi
#@DESCRIPTION: OE-lite distro for Raspberry Pi

MACHINE_OS      = "linux-gnu"
GCC_VERSION	?= "4.9.2"

DISTRO_USE_busybox_cron="1"
DISTRO_USE_toolchain_binutils_version = "2.22"

#
# Common options
#
DISTRO_USE_sysvinit = "1"
DISTRO_USE_crontab = "1"
DISTRO_USE_mdev = "1"

DISTRO_USE_passwd_root = "$1$L9mzJfTZ$2ED5as2K2yZ98CN/BQuy1."

#
# Base-files setup
# 
DISTRO_USE_hostname = "rpi-host"
DISTRO_USE_busybox_ntpd_configuration = "-p 0.europe.pool.ntp.org -p 1.europe.pool.ntp.org"
```

## conf/distro/sensor.conf
```bitbake
#@TYPE: Distribution
#@NAME: sensor 
#@DESCRIPTION: OE-lite distro for sensor RF24 gateway

MACHINE_OS      = "linux-gnu"
GCC_VERSION	?= "4.9.2"

#busybox
DISTRO_USE_busybox_cron="1"
DISTRO_USE_busybox_adduser = "1"
DISTRO_USE_busybox_su = "1"
DISTRO_USE_busybox_losetup = "1"
DISTRO_USE_busybox_feature_mount_loop = "1"
DISTRO_USE_busybox_uniq = "1"
DISTRO_USE_busybox_sort = "1"
DISTRO_USE_busybox_ntpd = "1"
DISTRO_USE_busybox_ntpd_configuration = "-q -p ptbtime1.ptb.de"
DISTRO_USE_busybox_base64 = "1"

DISTRO_USE_toolchain_binutils_version = "2.22"

#
# Common options
#
DISTRO_USE_sysvinit = "1"
DISTRO_USE_crontab = "1"
DISTRO_USE_mdev = "1"

DISTRO_USE_fstab = "1"

DISTRO_USE_passwd_root = "$1$L9mzJfTZ$2ED5as2K2yZ98CN/BQuy1."

#
# Base-files setup
# 
DISTRO_USE_hostname = "sensor-gw"
DISTRO_USE_busybox_ntpd_configuration = "-p 0.europe.pool.ntp.org -p 1.europe.pool.ntp.org"


DISTRO_USE_rootfs_rdepends = "\
	 base-hostname \
	 base-passwd \
	 netbase \
	 dupdate \
	 fstab dropbear \
	 e2fsprogs-mke2fs \
	 kernel-modules \
	 util/iw wpa-supplicant firmware-ralink modules-init \
	 gpio-event-app \
	 vandmaaler-autostart \
	 hiawatha \
	 s3-bash \
	 homemonitor \
	 rf-gw \
	 "
```

## conf/distro/webserver.conf
```bitbake
#@TYPE: Distribution
#@NAME: webserver
#@DESCRIPTION: OE-lite distro for webserver

MACHINE_OS      = "linux-gnu"
GCC_VERSION	?= "4.9.2"

#busybox
DISTRO_USE_busybox_cron="1"
DISTRO_USE_busybox_adduser = "1"
DISTRO_USE_busybox_su = "1"
DISTRO_USE_busybox_losetup = "1"
DISTRO_USE_busybox_feature_mount_loop = "1"
DISTRO_USE_busybox_uniq = "1"
DISTRO_USE_busybox_sort = "1"

DISTRO_USE_toolchain_binutils_version = "2.22"

#
# Common options
#
DISTRO_USE_sysvinit = "1"
DISTRO_USE_crontab = "1"
DISTRO_USE_mdev = "1"

DISTRO_USE_passwd_root = "$1$L9mzJfTZ$2ED5as2K2yZ98CN/BQuy1."

#
# Base-files setup
# 
DISTRO_USE_hostname = "webserver"
DISTRO_USE_busybox_ntpd_configuration = "-p 0.europe.pool.ntp.org -p 1.europe.pool.ntp.org"

DISTRO_USE_rootfs_rdepends = "\
	 base-hostname \
	 base-passwd \
	 netbase \
	 config \
	 openssh \
	 hiawatha \
	 ushare \
	 cups-cupsd cups-samsung-ml3050 cups-cupsctl cups-cupsfilter \
	 samba-smbd samba-smbpasswd \
	 dupdate \
	 e2fsprogs-mke2fs \
	 hdparm  \
	 "
```

## conf/machine/itron-at91.conf
```bitbake
MACHINE_USE_kernel_imagetype = "uImage"
MACHINE_USE_busybox_inittab_login = "::respawn:/sbin/getty 115200 /dev/ttyAMA0 vt100"

MACHINE_CPU	= "arm-926ejs"

DEFAULT_USE_at91bootstrap_config = "at91sam9rleknf_uboot_defconfig"

MACHINE_USE_uboot_config = "at91sam9rlek_mmc_defconfig"

MACHINE_USE_kernel_defconfig = "at91_dt_defconfig"
MACHINE_USE_kernel_uimage_loadaddress="0x20008000"
MACHINE_USE_kernel_dtc_source = "arch/arm/boot/dts//at91sam9rlek.dts"
prefer package kernel recipe at91-linux
```

## conf/machine/rpi-adapter.conf
```bitbake
include rpi-common.inc

MACHINE_USE_rootfs_rdepends = "\
	 base-hostname \
	 base-passwd \
	 netbase \
	 dupdate \
	 fstab dropbear \
	 e2fsprogs-mke2fs \
	 kernel-modules \
	 util/iw wpa-supplicant firmware-ralink modules-init \
	 ser2net \
	 "
```

## conf/machine/rpi.conf
```bitbake
MACHINE_USE_kernel_imagetype = "Image"
MACHINE_USE_netbase_auto_if = "lo eth0"
MACHINE_USE_busybox_inittab_login = "::respawn:/sbin/getty 115200 /dev/ttyAMA0 vt100"

MACHINE_CPU	= "arm-1176jzfs"
MACHINE_ABI	= "hard"

#
# firmware for bootup / graphics, video, etc see meta/bcm2835/recipes/firmware.inc
#
MACHINE_USE_fw_srcrev = "commit=3ab17ac25e92ade48325472994b6660c5efd05b5"
MACHINE_USE_fw_version = "20130821"
```

## conf/machine/viac3.conf
```bitbake
MACHINE_CPU	 = "i586-c3"
MACHINE_OS	 = "linux-gnu"

MACHINE_USE_linux_srcrev = "tag=v3.10.29"
MACHINE_USE_kernel_imagetype = "bzImage"
MACHINE_USE_kernel_defconfig = "0"
MACHINE_USE_fstab = "1"

MACHINE_USE_rootfs_rdepends = "syslinux-extlinux"
```
